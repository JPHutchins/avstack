## tests/fixtures/ZSWatch/build/Kconfig/Kconfig.shield
```kconfig
osource "C:/Users/jp/repos/ZSWatch/app/boards/shields/*/Kconfig.shield"
osource "C:/ncs/v2.2.0/nrf/boards/shields/*/Kconfig.shield"
```

## tests/fixtures/ZSWatch/build/Kconfig/Kconfig.shield.defconfig
```kconfig
osource "C:/Users/jp/repos/ZSWatch/app/boards/shields/*/Kconfig.defconfig"
osource "C:/ncs/v2.2.0/nrf/boards/shields/*/Kconfig.defconfig"
```
